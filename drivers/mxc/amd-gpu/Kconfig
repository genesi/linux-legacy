## drivers/mxc/amd-gpu/Kconfig
```kconfig
#
# Bluetooth configuration
#

menu "MXC GPU support"

config MXC_KGSL
	tristate "i.MX35/50/51/53 KGSL GPU Support"
	depends on ARCH_MX35 || ARCH_MX51 || ARCH_MX53 || ARCH_MX50
	---help---
	 Say Y to get the KGSL (AMD Imageon Z160/Z430) GPU driver support.

config KGSL_MMU_ENABLE
	bool "Enable the GPU MMU in the KGSL driver"
	depends on MXC_KGSL && MMU
	default y

config KGSL_FINE_GRAINED_LOCKING
	bool "Enable fine-grained locking in the KGSL driver"
	depends on MXC_KGSL
	default n
	---help---
	 Currently has some serialization issues, only enable if
	 you are willing to solve them. For now, N!

config KGSL_MMU_PAGE_FAULT
	bool "Force the GPU MMU to page fault for unmapped regions"
	default n
	depends on KGSL_MMU_ENABLE
	---help---
	 This is probably a terrible idea... please say N

endmenu
```

## drivers/staging/udlfb/Kconfig
```kconfig
config FB_UDL
	tristate "Displaylink USB Framebuffer support"
	depends on FB && USB
	select FB_MODE_HELPERS
	select FB_SYS_FILLRECT
	select FB_SYS_COPYAREA
	select FB_SYS_IMAGEBLIT
	select FB_SYS_FOPS
	select FB_DEFERRED_IO
	---help---
	  This is an experimental driver for DisplayLink USB devices
	  that provides a framebuffer device.  A normal framebuffer can
	  be used with this driver, or xorg can be run on the device
	  using it.
```
